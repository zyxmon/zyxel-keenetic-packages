## toolchain/gcc/Config.in
```kconfig
# Choose gcc version.

choice
	prompt "GCC compiler Version" if TOOLCHAINOPTS
	default GCC_VERSION_4_3_3_CS if (mips || mipsel) && !(TARGET_octeon || TARGET_sibyte)
	default GCC_VERSION_4_1_2
	help
	  Select the version of gcc you wish to use.

	config GCC_VERSION_4_1_2
		bool "gcc 4.1.2"

	config GCC_VERSION_4_3_3_CS
		bool "gcc 4.3.3 with CodeSourcery enhancements"


endchoice

config EXTRA_GCC_CONFIG_OPTIONS
	string
	prompt "Additional gcc configure options" if TOOLCHAINOPTS
	default ""
	help
	    Any additional gcc options you may want to include....

config SSP_SUPPORT
	bool
	prompt "Enable Stack-Smashing Protection support" if TOOLCHAINOPTS
	default n
	help
	    Enable Stack-Smashing Protection support

config TLS_SUPPORT
	bool
	depends UCLIBC_VERSION_NPTL
	prompt "Enable Thread-local storage (TLS) support" if TOOLCHAINOPTS
	default n
	help
	    Enable Thread-local storage support

config INSTALL_LIBSTDCPP
	bool
	prompt "Build/install c++ compiler and libstdc++?" if TOOLCHAINOPTS
	default y
	help
	    Build/install c++ compiler and libstdc++?
```

## trunk/package/wpa_supplicant/Config.in
```kconfig
# wpa_supplicant configuration

config WPASUPP_RALINK
	bool
	default n
	prompt "Support Ralink RT2860"

config WPASUPP_OPENSSL
	bool
	default n
	prompt "Support OpenSSL"
```

## trunk/toolchain/gcc/Config.in
```kconfig
# Choose gcc version.

choice
	prompt "GCC compiler Version" if TOOLCHAINOPTS
	default GCC_VERSION_4_1_2
	help
	  Select the version of gcc you wish to use.

	config GCC_VERSION_4_1_2
		bool "gcc 4.1.2"
endchoice

config EXTRA_GCC_CONFIG_OPTIONS
	string
	prompt "Additional gcc configure options" if TOOLCHAINOPTS
	default ""
	help
	    Any additional gcc options you may want to include....

config SSP_SUPPORT
	bool
	prompt "Enable Stack-Smashing Protection support" if TOOLCHAINOPTS
	default n
	help
	    Enable Stack-Smashing Protection support

config INSTALL_LIBSTDCPP
	bool
	prompt "Build/install c++ compiler and libstdc++?" if TOOLCHAINOPTS
	default y
	help
	    Build/install c++ compiler and libstdc++?
```
